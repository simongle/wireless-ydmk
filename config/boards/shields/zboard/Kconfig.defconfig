## config/boards/shields/zboard/Kconfig.defconfig
```kconfig
# Copyright (c) 2020 The ZMK Contributors
# SPDX-License-Identifier: MIT

if SHIELD_ZDMK_LEFT

config ZMK_KEYBOARD_NAME
	default "ZDMK"

config ZMK_SPLIT_BLE_ROLE_CENTRAL
	default y

endif

if SHIELD_ZDMK_LEFT || SHIELD_ZDMK_RIGHT

config ZMK_SPLIT
	default y

endif
```
